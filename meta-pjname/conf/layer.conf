## meta-pjname/conf/layer.conf
```bitbake
# We have a conf and classes directory, add to BBPATH
BBPATH .= ":${LAYERDIR}"

# We have recipes-* directories, add to BBFILES
BBFILES += "${LAYERDIR}/recipes-*/*/*.bb \
            ${LAYERDIR}/recipes-*/*/*.bbappend"

BBFILE_COLLECTIONS += "meta-pjname"
BBFILE_PATTERN_meta-pjname = "^${LAYERDIR}/"
BBFILE_PRIORITY_meta-pjname = "6"

LAYERDEPENDS_meta-pjname = "core"
LAYERSERIES_COMPAT_meta-pjname = "kirkstone"
```

## meta-pjname/conf/machine/pjname.conf
```bitbake
#@TYPE: Machine
#@NAME: AM335x EVM
#@DESCRIPTION: Machine configuration for the TI AM335x EVM

require conf/machine/include/ti33x.inc

# Normally AM335 boards use ttyS0, but ICE uses ttyS3, so try both
SERIAL_CONSOLES = "115200;ttyS0 115200;ttyS3"
SERIAL_CONSOLES_CHECK = "${SERIAL_CONSOLES}"
```

## meta-pxz/conf/layer.conf
```bitbake
# We have a conf and classes directory, add to BBPATH
BBPATH .= ":${LAYERDIR}"

# We have recipes-* directories, add to BBFILES
BBFILES += "${LAYERDIR}/recipes-*/*/*.bb \
            ${LAYERDIR}/recipes-*/*/*.bbappend"

BBFILE_COLLECTIONS += "meta-pxz"
BBFILE_PATTERN_meta-pxz = "^${LAYERDIR}/"
BBFILE_PRIORITY_meta-pxz = "6"

LAYERDEPENDS_meta-pxz = "core"
LAYERSERIES_COMPAT_meta-pxz = "kirkstone"
```
